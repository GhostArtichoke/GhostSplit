## config/Kconfig.defconfig.txt
```kconfig
if SHIELD_GHOSTSPLIT_LEFT

config ZMK_KEYBOARD_NAME
    default "GhostSplit"

config ZMK_SPLIT_ROLE_CENTRAL
    default y

endif

if SHIELD_GHOSTSPLIT_LEFT || SHIELD_GHOSTSPLIT_RIGHT

config ZMK_SPLIT
    default y

endif
```

## config/Kconfig.shield.txt
```kconfig
config SHIELD_CALDERA_LEFT
    def_bool $(shields_list_contains,GhostSplit_left)

config SHIELD_CALDERA_RIGHT
    def_bool $(shields_list_contains,GhostSplit_right)
```

## config/boards/shields/GhostSplit/Kconfig.shield.txt
```kconfig
config SHIELD_GHOSTSPLIT_LEFT
    def_bool $(shields_list_contains,GhostSplit_left)

config SHIELD_GHOSTSPLIT_RIGHT
    def_bool $(shields_list_contains,GhostSplit_right)
```
